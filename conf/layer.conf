## conf/layer.conf
```bitbake
# We have a conf and classes directory, add to BBPATH
BBPATH .= ":${LAYERDIR}"

# We have recipes-* directories, add to BBFILES
BBFILES += "${LAYERDIR}/recipes-*/*/*.bb \
            ${LAYERDIR}/recipes-*/*/*.bbappend"

BBFILE_COLLECTIONS += "meta-iotc-sdk-lite"
BBFILE_PATTERN_meta-iotc-sdk-lite = "^${LAYERDIR}/"
BBFILE_PRIORITY_meta-iotc-sdk-lite = "6"

LAYERDEPENDS_meta-iotc-sdk-lite = "core"
LAYERSERIES_COMPAT_meta-iotc-sdk-lite = "mickledore"

CORE_IMAGE_EXTRA_INSTALL += " kernel-modules"

IMAGE_INSTALL += " ${CORE_IMAGE_EXTRA_INSTALL}"

IMAGE_INSTALL += " curl"
IMAGE_INSTALL += " packagegroup-core-boot"

IMAGE_LINGUAS = " "
```
